one code 0x000000
    DB  0x13,0xD0,0xFF,0xFF,0xFF,0xFF,0xFF,0xFF,0x92,0xD3,0xFF,0xFF,0xFF,0xFF,0xFF,0xFF
    DB  0x07,0xAC,0x2B,0xFF,0xFF,0xFF,0xFF,0xFF,0x45,0xD1,0xFF,0xFF,0xFF,0xFF,0xFF,0xFF
    DB  0x30,0x00,0x03,0xFF,0xFF,0xFF,SN_1,SN_2,0x75,0x6A,0x74,0x6A,0x7F,0x9E,0x7F,0x9C
    DB  0x7F,0x80,0x73,0x3C,0x02,0xD0,0x68,0xEF,0x05,0xF0,0x74,0xD8,0xAF,0xD8,0xFA,0xD8
    DB  0xE7,0xD8,0x40,0xD8,0x06,0xD8,0x01,0x01,0x60,0xA1,0x10,0xEF,0x08,0xF0,0x03,0x00
    DB  0xFE,0xD7,0x93,0x9C,0x8A,0x8C,0x01,0x01,0x6F,0x67,0x08,0xD0,0x17,0xD8,0x8A,0x9C
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    DB  0x2F,0xD7,0xFF,0xFF,0xFF,0xFF,0xFF,0xFF,0xFF,0xFF,0xFF,0xFF,0xFF,0xFF,0xFF,0xFF
two code 0x300000
    DB  0x15,0x03,0x2A,0x2E,0xFF,0x89,0x91,0xFF,0x00,0x00,0x0F,0x80,0x0F,0x00
three code 0xF00000
    DE  0x00
four code 0xF00026
    DE  SN_1,SN_2
